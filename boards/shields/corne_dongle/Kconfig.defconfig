## boards/shields/corne_dongle/Kconfig.defconfig
```kconfig
if SHIELD_CORNE_DONGLE

# Max 16 characters in keyboard name
config ZMK_KEYBOARD_NAME
    default "Corne Dongle"

config ZMK_SPLIT_ROLE_CENTRAL
    default y

config ZMK_SPLIT
    default y

# Set this to the number of peripherals your dongle will have.
# For Corne (left + right halves), set it to 2
config ZMK_SPLIT_BLE_CENTRAL_PERIPHERALS
    default 2

# Set this to ZMK_SPLIT_BLE_CENTRAL_PERIPHERALS + your desired number of BT profiles (default is 5)
# 2 + 5 = 7
config BT_MAX_CONN
    default 7

# Set this to the same number as BT_MAX_CONN
config BT_MAX_PAIRED
    default 7

# --- DISPLAY CONFIGURATIONS ---
# Habilitar display
config ZMK_DISPLAY
    default y

# Usar status screen built-in (mostra bateria, layer, output)
config ZMK_DISPLAY_STATUS_SCREEN_BUILT_IN
    default y

# Blank display quando idle (economiza bateria OLED)
config ZMK_DISPLAY_BLANK_ON_IDLE
    default y

# Work queue dedicada para não atrasar key scanning
config ZMK_DISPLAY_WORK_QUEUE_DEDICATED
    default y

# --- WIDGETS ---
# Widget de bateria (habilitado por padrão)
config ZMK_WIDGET_BATTERY_STATUS
    default y

# Mostrar porcentagem ao invés de ícones
config ZMK_WIDGET_BATTERY_STATUS_SHOW_PERCENTAGE
    default y

# Widget de layer ativo
config ZMK_WIDGET_LAYER_STATUS
    default y

# Widget de status de output (USB/BLE)
config ZMK_WIDGET_OUTPUT_STATUS
    default y

# --- PERIPHERAL BATTERY MONITORING ---
# Fetch battery levels dos peripherals
config ZMK_SPLIT_BLE_CENTRAL_BATTERY_LEVEL_FETCHING
    default y

# Proxy battery levels para o host (opcional)
config ZMK_SPLIT_BLE_CENTRAL_BATTERY_LEVEL_PROXY
    default y

endif
```

## boards/shields/dongle/Kconfig.defconfig
```kconfig
if SHIELD_DONGLE

config ZMK_KEYBOARD_NAME
    default "Corne ReD"

config ZMK_SPLIT_ROLE_CENTRAL
    default y

config ZMK_SPLIT_ROLE_PERIPHERAL
    default y

config ZMK_SPLIT_BLE_CENTRAL_PERIPHERALS
    default 2

config BT_MAX_CONN
    default 6

config BT_MAX_PAIRED
    default 6

endif
```
