## boards/shields/charybdis/Kconfig.shield
```kconfig
# Copyright (c) 2024 The ZMK Contributors
# SPDX-License-Identifier: MIT

config SHIELD_CHARYBDIS_DONGLE
    def_bool $(shields_list_contains,charybdis_dongle)

config SHIELD_CHARYBDIS_LEFT
    def_bool $(shields_list_contains,charybdis_left)

config SHIELD_CHARYBDIS_RIGHT
    def_bool $(shields_list_contains,charybdis_right)
```
