#include <behaviors.dtsi>
#include <behaviors/num_word.dtsi> // requires auto-layer module
#include <dt-bindings/zmk/keys.h>
#include "zmk-helpers/helper.h"
#include <dt-bindings/zmk/bt.h>
#include <dt-bindings/zmk/outputs.h>

#define DEF 0
#define NAV 1
#define FN 2
#define NUM 3
#define SYS 4
#define MOUSE 5
#define GAME 6
#define DOTA 7
#define FUNGAME 8
#define NUMPAD 9

#define XXX &none
#define ___ &trans

/* Global settings */

#define QUICK_TAP_MS 175

&sk {  // sticky-key config
    release-after-ms = <900>;  // release after 0.9s
    quick-release;             // no double capitalization when rolling keys
};

&sl {  // sticky-layer config
    ignore-modifiers;          // allow chording sticky mods & layers
};

&lt {  // layer-tap config
    flavor = "balanced";
    tapping-term-ms = <200>;
    quick-tap-ms = <QUICK_TAP_MS>;
};

//&leader {  // leader-key config
//    timeout-ms = <650>;
//};



/* Timeless homerow mods */

// https://github.com/urob/zmk-config/tree/main#timeless-homerow-mods
#define KEYS_L LT0 LT1 LT2 LT3 LT4 LM0 LM1 LM2 LM3 LM4 LB0 LB1 LB2 LB3 LB4  // left hand
#define KEYS_R RT0 RT1 RT2 RT3 RT4 RM0 RM1 RM2 RM3 RM4 RB0 RB1 RB2 RB3 RB4  // right hand
#define THUMBS LH2 LH1 LH0 RH0 RH1 RH2                                      // thumbs

#define MAKE_HRM(NAME, HOLD, TAP, TRIGGER_POS) \
    ZMK_HOLD_TAP(NAME, \
        flavor = "balanced"; \
        tapping-term-ms = <280>; \
        quick-tap-ms = <QUICK_TAP_MS>; \
        require-prior-idle-ms = <150>; \
        bindings = <HOLD>, <TAP>; \
        hold-trigger-key-positions = <TRIGGER_POS>; \
        hold-trigger-on-release; \
    )
MAKE_HRM(hml, &kp, &kp, KEYS_R THUMBS)  // left-hand HRMs
MAKE_HRM(hmr, &kp, &kp, KEYS_L THUMBS)  // right-hand HRMs

// HRM combo hack - workaround for lack of tap-only combos (ZMK issue #544)
#define ZMK_COMBO_8(NAME, TAP, KEYPOS, LAYERS, COMBO_TERM, COMBO_IDLE, HOLD, SIDE) \
    MAKE_HRM(hm_combo_ ## NAME, &kp, TAP, SIDE THUMBS) \
    ZMK_COMBO_6(NAME, &hm_combo_ ## NAME HOLD 0, KEYPOS, LAYERS, COMBO_TERM, COMBO_IDLE)

/*Mouse, combos */
#include "mouse.dtsi"
#include "combos.dtsi"


#define MT_CORE \
    flavor = "tap-preferred"; \
    tapping-term-ms = <220>; \
    quick-tap-ms = <220>; \
    hold-trigger-key-positions = <0>;

&mt { MT_CORE };
ZMK_HOLD_TAP(mt_home, bindings = <&masked_home>, <&kp>; MT_CORE)
ZMK_HOLD_TAP(mt_end, bindings = <&masked_end>, <&kp>; MT_CORE)

#define NAV_LEFT  &mt_home 0   LEFT    // tap: left  | long-tap: beginning of line
#define NAV_RIGHT &mt_end 0    RIGHT   // tap: right | long-tap: end       of line
#define NAV_UP    &mt LC(HOME) UP      // tap: up    | long-tap: beginning of document
#define NAV_DOWN  &mt LC(END)  DOWN    // tap: down  | long-tap: end       of document
#define NAV_BSPC  &mt LC(BSPC) BSPC    // tap: bspc  | long-tap: delete word backward
#define NAV_DEL   &mt LC(DEL)  DEL

// misc aliases
#define CANCEL      &kp K_CANCEL             // cancel caps-word, num-word and smart-mouse
#define DSK_PREV    &hmr LCTRL LG(LC(LEFT))  // previous desktop
#define DSK_NEXT    &hmr LCTRL LG(LC(RIGHT))  // next     desktop
#define PIN_WIN     &kp LG(LC(LS(Q)))        // pin window across desktops
#define PIN_APP     &kp LG(LC(LS(A)))        // pin application across desktops
#define DSK_MGR     &kp LA(GRAVE)            // desktop manager
#define VOL_DOWN    &hmr RSHFT C_VOL_DN
#define VOL_UP      &kp C_VOL_UP

// mask CTRL when holding left/right to avoid accidental jumps to beginning/end of document
#define MASK_MODS(NAME, MODS, BINDING) \
    ZMK_MOD_MORPH(NAME, \
        bindings = <BINDING>, <BINDING>; \
        mods = <MODS>; \
    )
MASK_MODS(masked_home, (MOD_LCTL), &kp HOME)
MASK_MODS(masked_end,  (MOD_LCTL), &kp END)

/* Caps-word, num-word and smart-mouse */

// tap: sticky-shift | shift + tap/ double-tap: caps-word | hold: shift
ZMK_MOD_MORPH(smart_shft,
    bindings = <&sk LSHFT>, <&caps_word>;
    mods = <(MOD_LSFT)>;
)
&caps_word {  // mods deactivate caps-word, requires PR #1451
    /delete-property/ ignore-modifiers;
};

// tap: num-word | double-tap: sticky num-layer | hold: num-layer
#define SMART_NUM &smart_num NUM 3
ZMK_HOLD_TAP(smart_num,
    flavor = "balanced";
    tapping-term-ms = <200>;
    quick-tap-ms = <QUICK_TAP_MS>;
    bindings = <&mo>, <&num_dance>;
)
ZMK_TAP_DANCE(num_dance,
    tapping-term-ms = <200>;
    bindings = <&num_word NUM>, <&sl NUM>;  // reverse this for sticky-num on single tap
)

// smart-mouse, requires PR #1366
ZMK_TRI_STATE(smart_mouse,
    bindings = <&tog MOUSE>, <&none>, <&tog MOUSE>;
    ignored-key-positions = <LT1 LT3 RT0 RT1 RT3 RT4 RM0 RM1 RM2 RM3 RB1 RB2 RB3 RH0 RH1>;
    ignored-layers = <MOUSE>;
)

ZMK_HOLD_TAP(hml,
    flavor = "balanced";
    tapping-term-ms = <280>;
    require-prior-idle-ms = <150>;
    hold-trigger-key-positions = <KEYS_R THUMBS>;
    hold-trigger-on-release;
    bindings = <&kp>, <&kp>;
)

ZMK_HOLD_TAP(hmr,
    flavor = "balanced";
    tapping-term-ms = <280>;
    require-prior-idle-ms = <150>;
    hold-trigger-key-positions = <KEYS_L THUMBS>;
    hold-trigger-on-release;
    bindings = <&kp>, <&kp>;
)

/* Custom behaviors */

// tap: copy | double-tap: cut
ZMK_TAP_DANCE(copy_cut,
    tapping-term-ms = <200>;
    bindings = <&kp LC(INS)>, <&kp LC(X)>;
)

// tap: backspace | shift + tap: delete
ZMK_MOD_MORPH(bs_del,
    bindings = <&kp BSPC>, <&kp DEL>;
    mods = <(MOD_LSFT|MOD_RSFT)>;
)

// windows sleep macro
ZMK_MACRO(win_sleep,
    wait-ms = <100>;
    tap-ms = <5>;
    bindings = <&kp LG(X) &kp U &kp S>;
)

// Alt+Tab swapper, requires PR #1366
ZMK_TRI_STATE(swapper,
    bindings = <&kt LALT>, <&kp TAB>, <&kt LALT>;
    ignored-key-positions = <LT2>;
)


// combos
ZMK_COMBO(sleep,    &win_sleep,  RT3 RT4, NAV)  // put Windows to sleep, only active on NAV layer
ZMK_COMBO(copy_cut, &copy_cut,   LB2 LB3, ALL)  // copy on tap, cut on double-tap, active on all layers
ZMK_COMBO(paste,    &kp LS(INS), LB1 LB2, ALL)  // paste, active on all layers



/*Keymap*/

ZMK_CONDITIONAL_LAYER(sys, FN NUM, SYS)  // FN + NUM --> SYS
/ {
  keymap {
    compatible = "zmk,keymap";
base {
    bindings = <
//╭─────────┬──────────────────┬──                                                     ┬
___   &kp Q  &mt RC(F2) W       &kp E               &kp R              &kp T             &mt LS(F6) Y    &kp U           &kp I                 &mt LS(F9) O      &kp P          ___
___   &kp A  &hml LEFT_SHIFT S  &hml LEFT_CONTROL D &hml LEFT_ALT F    &hml LEFT_GUI G   &hmr LEFT_GUI H &hmr LEFT_ALT J &hmr LEFT_CONTROL K   &hmr LEFT_SHIFT L &kp SEMICOLON  &kp SQT
___   &kp Z  &kp X              &kp C               &kp V              &kp B             &kp N           &kp M           &kp COMMA             &kp DOT           &kp FSLH       &smart_shft
                                &lt FN ESC          &lt NAV LEFT_GUI   &kp TAB           &kp RET         &lt NUM SPACE   &bs_del
    >;
display-name = "base";
};


nav {
    bindings = <
//1                                                                        6            ┬  1                                                                                               6
&kp TILDE         &kp EXCL  &kp AT          &kp HASH          &kp DOLLAR   &kp PERCENT    &kp CARET        &kp AMPERSAND  &mt ASTERISK LEFT_PARENTHESIS  &kp RIGHT_PARENTHESIS  &mt UNDER KP_MINUS  &mt PLUS EQUAL
&trans            &swapper  &sk LEFT_SHIFT  &sk LEFT_CONTROL  &sk LEFT_ALT &sk LEFT_GUI   NAV_LEFT         NAV_DOWN       NAV_UP                NAV_RIGHT              &kp LEFT_BRACKET    &kp RIGHT_BRACKET
&kp LC(LEFT_GUI)  &trans    &trans          &trans            &trans       &trans         &kp INS          &kp HOME       &kp PAGE_DOWN         &kp PG_UP              &kp END             &trans
                                            &trans            &trans       &kp SPACE      &kp RET          CANCEL         &kp RALT
    >;
display-name = "nav";
};

fn{
    bindings = <
//1                                                                               6       ┬   1                                                                          6
//╭─────────────┬──────────────┬───────────────┬─────────────┬─────────────┬─────────────╮ ╭─────────────────┬─────────────┬─────────────┬─────────────┬──────────────┬────────────╮
    &kp F12       &kp F7          &kp F8        &kp F9          ___            ___            ___               ___            ___           ___             ___           ___
//├─────────────┼──────────────┼───────────────┼─────────────┼─────────────┤─────────────┤ ├─────────────────┼─────────────┼─────────────┼─────────────┼──────────────┼────────────┤
    &kp F11       &hml LSHFT F4   &hml LCTRL F5 &hml LALT F6    ___             ___           DSK_PREV          VOL_DOWN     &kp C_VOL_UP   DSK_NEXT          ___           ___
//├─────────────┼──────────────┼───────────────┼─────────────┼─────────────┼─────────────┤ ├─────────────────┼─────────────┼─────────────┼─────────────┼──────────────┼────────────┤
    &kp F10       &kp F1          &kp F2        &kp F3          ___             ___          &kp PRINTSCREEN      ___          ___           ___             ___           ___
//╰─────────────┴──────────────┴───────────────┼─────────────┼─────────────┼─────────────┤ ├─────────────────┼─────────────┼─────────────┼─────────────┴──────────────┴────────────╯
                                                     ___          ___           ___          &kp LCTRL         &kp LALT      &kp C_PP
//                                             ╰─────────────┴─────────────┴─────────────╯ ╰─────────────────┴─────────────┴─────────────╯
    >;
display-name = "fn";
};

num{
    bindings = <
// todo: smart_num
&kp GRAVE  &kp N1  &kp N2  &kp N3  &kp N4        &kp N5       &kp N6         &kp N7   &kp N8  &kp N9  &kp N0    &kp BSPC
&kp LCTRL  &trans  &trans  &trans  &trans        &trans       &kp MINUS      &kp N4   &kp N5  &kp N6  &kp BSLH  &kp GRAVE
&kp LSHFT  &trans  &trans  &trans  &trans        &tog GAME    ___            &kp N1   &kp N2  &kp N3  &kp PIPE  &kp TILDE
                           &trans  &smart_num    &trans       ___            ___      &kp RALT
    >;
display-name = "num";
};

sys{
    bindings = <
&trans  &trans  &trans  &trans  &trans  &trans        &out OUT_TOG   &trans        &trans  &trans  &bt BT_CLR    &bt BT_CLR_ALL
&trans  &trans  &trans  &trans  &trans  &trans        &trans         &trans        &trans  &trans  &bt BT_SEL 2  &bt BT_SEL 3
&trans  &trans  &trans  &trans  &trans  &trans        &trans         &trans        &trans  &trans  &bt BT_SEL 0  &bt BT_SEL 1
                        &trans  &trans  &trans        &trans         &trans        &trans
    >;
display-name = "sys";
};

mouse {
    bindings = <
//╭───────┬─────────────┬─────────────┬─────────────┬─────────────┬─────────────╮       ╭─────────────┬─────────────┬─────────────┬─────────────┬─────────────╮ ╭──────╮
    ___     ___           ___           ___           ___           ___                      U_WH_L        U_WH_D        U_WH_U       U_WH_R        ___            ___
//├──────┤ ├─────────────┼─────────────┼─────────────┼─────────────┼─────────────┤      ├─────────────┼─────────────┼─────────────┼─────────────┼─────────────┤ ├──────┤
    ___     ___           ___           ___           ___           ___                       U_MS_L      U_MS_D        U_MS_U       U_MS_R          ___           ___
//├──────┤ ├─────────────┼─────────────┼─────────────┼─────────────┼─────────────┤       ├─────────────┼─────────────┼─────────────┼─────────────┼─────────────┤ ├──────┤
    ___      ___           ___           ___           ___           ___                      ___           &mkp MB4      &mkp MCLK      &mkp MB5     ___           ___
//├──────┤ ╰─────────────┼─────────────┴─────────────┼─────────────┼─────────────┤        ├─────────────┼─────────────┼─────────────┴───────────────────────────╯ ├──────┤
    ___                                               ___           ___                       &mkp LCLK     &mkp RCLK                                               ___
//╰──────╯                                           ╰─────────────┴─────────────╯       ╰─────────────┴─────────────╯                                           ╰──────╯
    >;
display-name = "mouse";
};

GAME {
    bindings = <
          &kp ESC       &kp Q  &kp W  &kp E   &kp R         &kp T      &kp Y      &kp U   &kp I      &kp O    &kp P     &trans
          &kp LSHFT     &kp A  &kp S  &kp D   &kp F         &kp G      &kp H      &kp J   &kp K      &kp L    &kp SEMI  &kp APOS
          &kp LCTRL     &kp Z  &kp X  &kp C   &kp V         &kp B      &kp N      &kp M   &kp COMMA  &kp DOT  &kp FSLH  &trans
                                   &trans  &lt FUNGAME SPACE  &kp TAB    &kp ENTER  &trans  &trans
    >;
display-name = "game";
};

dota {
    bindings = <
&trans        &kp Q  &kp W             &kp E           &kp R        &kp T      &kp Y   &kp U   &kp I      &kp O    &kp P     &kp BSPC
&trans        &kp A  &hml LEFT_SHIFT S  &mt LCTRL D     &mt LALT F   &kp G      &kp H   &kp J   &kp K      &kp L    &kp SEMI  &kp APOS
&kp LEFT_ALT  &kp Z  &kp X             &kp C           &kp V        &kp B      &kp N   &kp M   &kp COMMA  &kp DOT  &kp FSLH  &kp ENTER
                                       &kp LEFT_SHIFT  &lt FUNGAME SPACE  &kp TAB    &mt F3 ENTER  &lt SPACE F4  &kp F8
    >;
display-name = "dota";
};

fungame {
    bindings = <
&kp F12  &kp N1  &kp N2  &kp N3  &kp N4  &kp N5     &kp N6  &kp N7  &kp N8  &kp N9  &kp N0  &tog GAME
&kp F11  &kp F6  &kp F7  &kp F8  &kp F9  &kp F10    &trans  &trans  &trans  &trans  &trans  &trans
&trans   &kp F1  &kp F2  &kp F3  &kp F4  &kp F5     &trans  &trans  &trans  &trans  &trans  &trans
                                   &trans  &trans  &trans     &trans  &trans  &trans
    >;
display-name = "fungame";
};


    NUMPAD {
      bindings = <
&trans  &trans  &trans  &trans  &trans       &trans    &kp BACKSPACE  &kp N7  &kp N8  &kp N9  &kp MINUS        &kp PLUS
&trans  &trans  &trans  &trans  &trans       &trans    &kp KP_DOT     &kp N4  &kp N5  &kp N6  &kp KP_ASTERISK  &kp KP_DIVIDE
&trans  &trans  &trans  &trans  ___          ___       &trans         &kp N1  &kp N2  &kp N3  &trans           &trans
                        &trans  &tog NUMPAD  &trans    &trans         &kp N0  ___
      >;

      display-name = "NUMPAD";
    };




  };
};

/* vim: set ft=c tw=146: */
